## conf/machine/imx8xq-smarcore.conf
```bitbake
#@TYPE: Machine
#@NAME: i.MX 8QXP Smarcore GWC HPC
#@DESCRIPTION: i.MX 8QXP Smarcore - GWC HPC customizations
#@MAINTAINER: Engicam <support@engicam.com>


MACHINEOVERRIDES =. "mx8:mx8x:mx8qxp:mx8qxpsmarcore:mx8qxpc0"

IMX_DEFAULT_BSP = "nxp"

require conf/machine/include/imx-base.inc
require conf/machine/include/arm/armv8a/tune-cortexa35.inc

MACHINE_FEATURES:append =" wifi "

IMAGE_FSTYPES = "tar.bz2 ext4 wic.gz"

# Don't include kernels in standard images
RDEPENDS:${KERNEL_PACKAGE_NAME}-base = ""

LOADADDR = ""

# We have to disable SERIAL_CONSOLE due to auto-serial-console
SERIAL_CONSOLES = "115200;ttyAMA0"

# we do not want to have getty running on tty1 as we run
# auto-serial-console there
USE_VT = "0"

# Uncomment the following to use Engicam NXP Linux
#PREFERRED_PROVIDER_virtual/kernel = "linux-engicam"
# Uncomment the following to use Freescale IMX specific FSLC Linux
PREFERRED_PROVIDER_virtual/kernel = "linux-fslc-imx"
# else linux-fslc will be used (NOT TESTED)

# Uncomment the following to use Engicam UBoot
#PREFERRED_PROVIDER_virtual/bootloader = "u-boot-engicam"
# Uncomment the following to use Freescale IMX specific U-boot
PREFERRED_PROVIDER_virtual/bootloader = "u-boot-imx"
# else u-boot-fslc will be used (NOT TESTED)


# Currently delivers DTB for both dual and quad cores (dual is mostly quad with a few overrides)
KERNEL_DEVICETREE = "engicam/imx8xq-icore-starterkit.dtb engicam/imx8xd-icore-starterkit.dtb "

UBOOT_MAKE_TARGET = "u-boot.bin"
UBOOT_SUFFIX = "bin"
UBOOT_CONFIG ??= "sd"
# UBoot configuration for quad core (with 2GB Ram)
UBOOT_CONFIG[sd] = "imx8xq_icore_defconfig,sdcard"

# UBoot configuration for dual core (with 1GB Ram)
#UBOOT_CONFIG[sd] = "imx8xd_icore_defconfig,sdcard"

IMAGE_BOOTLOADER = "imx-boot"
IMX_BOOT_SEEK = "32"

IMXBOOT_TARGETS = \
    "${@bb.utils.contains('UBOOT_CONFIG',   'sd', 'flash', \
        bb.utils.contains('UBOOT_CONFIG', 'fspi', 'flash_flexspi', \
                                                  'UNKNOWN', d), d)}"

IMX_KERNEL_CONFIG_AARCH64_mx8qxpsmarcore = "imx8x_smarcore_defconfig"

BOARD_TYPE = "smarcore"

# Add additional firmware (needed only on EVB)
#MACHINE_FIRMWARE:append = " linux-firmware-bcm43430"

# Set u-boot DTB
UBOOT_DTB_NAME = "imx8x-icore.dtb"

#SECO_FIRMWARE_NAME        = \
#    "${@bb.utils.contains('MACHINE_FEATURES', 'soc-revb0', 'mx8qxb0-ahab-container.img', \
#                                                           'mx8qxc0-ahab-container.img', d)}"

SECO_FIRMWARE_NAME = "mx8qxc0-ahab-container.img"

ATF_PLATFORM = "imx8qx"
ATF_LOAD_ADDR = "0x970000"
#IMX_EXTRA_FIRMWARE = "firmware-imx-8m"

SC_FIRMWARE_NAME = "mx8qx-smarcore-scfw-tcm.bin"
SOC_FAMILY = "mx8x"
IMX_BOOT_SOC_TARGET = "iMX8QX"
SOC_TARGET = "iMX8QX"
REV_OPTION = "REV=C0"


SOC_DEFAULT_WKS_FILE = "imx-imx-boot-bootpart.wks.in"


# Remove some features really not needed for GWC HPC
DISTRO_FEATURES:remove = " alsa pcmcia opengl pulseaudio x11 nfc 3g pci bluetooth"

# Image Signing with NXP CSF
# To enable add "csfsigned" to MACHINEOVERRIDES
#MACHINEOVERRIDES =. "csfsigned:"

# CSFPATH = directory where CSF is installed (with keys already pre-generated)
CSFPATH = "/storage/mx8/cs-3.1.0"
# Undefine below TWO to generate also kernel signed container and put in wic image
SIGN_KERNEL = "yes"
IMAGE_BOOT_FILES:append:csfsigned = " os_cntr_signed.bin"



# Restrict locales to be generated
GLIBC_GENERATE_LOCALES = "en_GB.UTF-8 en_US.UTF-8"
LOCALE_UTF8_ONLY = "1"
# Disable ptest (we don't run them, very space consuming) and X graphics
DISTRO_FEATURES:remove = " ptest x11 wayland"


# RPM packaging and signing
PACKAGE_CLASSES = "package_rpm"
INHERIT += "sign_rpm"
RPM_GPG_NAME = "<KEY HERE>"
RPM_GPG_PASSPHRASE = "<PASS HERE>"
# GPG_PATH = "/directory/with/gpg/data"
IMAGE_INSTALL:append = " signing-keys-rpm"
```
